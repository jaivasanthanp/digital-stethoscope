/*
 * inference.cc — TFLite Micro interpreter wrapper (C++ source, Phase 2)
 *
 * Model: ResNet-10 INT8 (110 KB), generated by ml/03_quantize.py + ml/04_export.py
 * Ops:   Conv2D, FullyConnected, Add, MaxPool2D, Mean, Mul, Logistic, Reshape,
 *        Softmax, Concatenation, Gather, Pack (AllOpsResolver covers all of them)
 *
 * Tensor arena: 40 KB (measured used: 29332 bytes on first boot — 28% of 100 KB original)
 * Measured latency: 102 ms on Cortex-M33 @ 160 MHz with CMSIS-NN kernels
 */

#include "inference.h"
#include "model_data.h"

#include <zephyr/kernel.h>
#include <zephyr/logging/log.h>

#include "tensorflow/lite/micro/micro_interpreter.h"
#include "tensorflow/lite/micro/micro_mutable_op_resolver.h"
#include "tensorflow/lite/micro/system_setup.h"
#include "tensorflow/lite/schema/schema_generated.h"

LOG_MODULE_REGISTER(inference, LOG_LEVEL_INF);

/* ── Inference mutex ────────────────────────────────────────────────────── */
/* Shared with validate_thread — both must hold this before calling          */
/* inference_run(). TFLite Micro interpreter is not thread-safe.             */
K_MUTEX_DEFINE(g_inference_mutex);

/* ── Tensor arena ───────────────────────────────────────────────────────── */
/* Sized for the bigger ResNet-18 deployment (~700 K INT8 params). The
 * ResNet-10 baseline measured arena_used_bytes = 29332; ResNet-18 with
 * 32-channel stem and 128-channel head should land in the 80-130 KB range.
 * 200 KB leaves comfortable headroom on STM32U575's 768 KB SRAM, and the
 * arena_used_bytes log line on boot can be used to tighten this later.
 */
static uint8_t tensor_arena[200 * 1024] __attribute__((aligned(16)));

/* ── TFLite Micro state ─────────────────────────────────────────────────── */
static const tflite::Model       *s_model      = nullptr;
static tflite::MicroInterpreter  *s_interpreter = nullptr;
static TfLiteTensor              *s_input       = nullptr;
static TfLiteTensor              *s_output      = nullptr;

/*
 * Validation-calibrated uncertainty gate.
 *
 * Tuned on CirCor validation data after INT8 conversion. It promotes uncertain
 * Absent/Present argmax results to Unknown when the Unknown probability is
 * non-trivial and either the winning probability is modest or the top-2 margin
 * is small. This raises held-out Unknown recall at the cost of lower overall
 * accuracy, which is preferable for an advisory screening prototype.
 */
#define UNKNOWN_CLASS_ID       2
#define UNKNOWN_MIN_PROB       0.10f
#define UNKNOWN_TOP_MAX        0.60f
#define UNKNOWN_MARGIN_MAX     0.41f

/*
 * Op resolver for ResNet-10 INT8 with SE blocks.
 * Ops determined by inspecting resnet10_int8.tflite with:
 *   python -c "import tensorflow as tf; interp = tf.lite.Interpreter('ml/models/resnet10_int8.tflite');
 *              interp.allocate_tensors();
 *              [print(d['op_name']) for d in interp._get_ops_details()]"
 *
 * Ops found: ADD, CONV_2D, FULLY_CONNECTED, LOGISTIC, MAX_POOL_2D,
 *            MEAN, MUL, PACK, RESHAPE, SHAPE, SOFTMAX, STRIDED_SLICE
 * All 12 ops are supported by TFLite Micro with CMSIS-NN backend.
 */
static tflite::MicroMutableOpResolver<12> s_resolver;

/* ── Public API ─────────────────────────────────────────────────────────── */

extern "C" void inference_init(void)
{
    tflite::InitializeTarget();

    /* Load model from C array (generated by ml/04_export.py) */
    s_model = tflite::GetModel(g_model_data);
    if (s_model->version() != TFLITE_SCHEMA_VERSION) {
        LOG_ERR("Model schema version %u != runtime %u",
                s_model->version(), TFLITE_SCHEMA_VERSION);
        return;
    }

    /* Register ops — exact set from model inspection (12 ops) */
    s_resolver.AddConv2D();
    s_resolver.AddFullyConnected();
    s_resolver.AddAdd();
    s_resolver.AddMaxPool2D();
    s_resolver.AddMean();
    s_resolver.AddMul();
    s_resolver.AddLogistic();
    s_resolver.AddReshape();
    s_resolver.AddSoftmax();
    s_resolver.AddPack();
    s_resolver.AddShape();
    s_resolver.AddStridedSlice();

    /* Create interpreter */
    static tflite::MicroInterpreter interp(
        s_model, s_resolver, tensor_arena, sizeof(tensor_arena));
    s_interpreter = &interp;

    TfLiteStatus status = s_interpreter->AllocateTensors();
    if (status != kTfLiteOk) {
        LOG_ERR("AllocateTensors() failed — arena too small?");
        return;
    }

    s_input  = s_interpreter->input(0);
    s_output = s_interpreter->output(0);

    LOG_INF("TFLite Micro initialized");
    LOG_INF("  Model: %u bytes", g_model_data_len);
    LOG_INF("  Arena used: %u / %u bytes",
            (unsigned)s_interpreter->arena_used_bytes(),
            (unsigned)sizeof(tensor_arena));
    LOG_INF("  Input:  [%d, %d, %d, %d]  type=%d",
            s_input->dims->data[0], s_input->dims->data[1],
            s_input->dims->data[2], s_input->dims->data[3],
            s_input->type);
    LOG_INF("  Output: [%d, %d]  type=%d",
            s_output->dims->data[0], s_output->dims->data[1],
            s_output->type);
}

static int run_inference_core(const float *spec_in, size_t n_elements,
                              uint8_t *confidence, uint8_t raw_probs[3],
                              uint8_t *gate_applied)
{
    if (!s_interpreter || !s_input || !s_output) {
        LOG_ERR("Inference not initialized");
        return -1;
    }

    /* Quantize float32 spectrogram → INT8 input tensor */
    const float in_scale = s_input->params.scale;
    const int   in_zp    = s_input->params.zero_point;
    int8_t *in_data = s_input->data.int8;

    for (size_t i = 0; i < n_elements; i++) {
        int32_t q = (int32_t)(spec_in[i] / in_scale) + in_zp;
        in_data[i] = (int8_t)(q < -128 ? -128 : (q > 127 ? 127 : q));
    }

    /* Run inference */
    TfLiteStatus status = s_interpreter->Invoke();
    if (status != kTfLiteOk) {
        LOG_ERR("Invoke() failed: %d", status);
        return -1;
    }

    /* Dequantize INT8 output → float32 probabilities, find argmax */
    const float out_scale = s_output->params.scale;
    const int   out_zp    = s_output->params.zero_point;
    const int8_t *out_data = s_output->data.int8;

    int   best_class   = 0;
    int   raw_argmax   = 0;
    float best_prob    = -1.0f;
    float second_prob  = -1.0f;
    float unknown_prob = 0.0f;

    const int n_classes = s_output->dims->data[1];
    for (int c = 0; c < n_classes; c++) {
        float prob = (out_data[c] - out_zp) * out_scale;

        if (raw_probs != nullptr && c < 3) {
            float pct = prob * 100.0f + 0.5f;
            if (pct < 0.0f) pct = 0.0f;
            if (pct > 100.0f) pct = 100.0f;
            raw_probs[c] = (uint8_t)pct;
        }

        if (prob > best_prob) {
            second_prob = best_prob;
            best_prob  = prob;
            best_class = c;
            raw_argmax = c;
        } else if (prob > second_prob) {
            second_prob = prob;
        }

        if (c == UNKNOWN_CLASS_ID) {
            unknown_prob = prob;
        }
    }

    const float margin = best_prob - second_prob;
    uint8_t gated = 0;
    if (n_classes > UNKNOWN_CLASS_ID &&
        best_class != UNKNOWN_CLASS_ID &&
        unknown_prob >= UNKNOWN_MIN_PROB &&
        (best_prob <= UNKNOWN_TOP_MAX || margin <= UNKNOWN_MARGIN_MAX)) {
        best_class = UNKNOWN_CLASS_ID;
        best_prob = unknown_prob;
        gated = 1;
    }

    if (gate_applied != nullptr) {
        *gate_applied = gated;
    }

    /* Backfill any unfilled raw_probs slots when model has < 3 outputs. */
    if (raw_probs != nullptr) {
        for (int c = n_classes; c < 3; c++) {
            raw_probs[c] = 0;
        }
    }

    (void)raw_argmax;
    *confidence = (uint8_t)(best_prob * 100.0f + 0.5f);
    return best_class;
}

extern "C" int inference_run(const float *spec_in, size_t n_elements,
                              uint8_t *confidence)
{
    return run_inference_core(spec_in, n_elements, confidence, nullptr, nullptr);
}

extern "C" int inference_run_probs(const float *spec_in, size_t n_elements,
                                    uint8_t *confidence, uint8_t raw_probs[3],
                                    uint8_t *gate_applied)
{
    return run_inference_core(spec_in, n_elements, confidence, raw_probs, gate_applied);
}
