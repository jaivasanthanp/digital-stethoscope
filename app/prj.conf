## CMakeLists.txt
```
cmake_minimum_required(VERSION 3.20.0)
find_package(Zephyr REQUIRED HINTS $ENV{ZEPHYR_BASE})

project(digital_stethoscope)

# Core application sources
target_sources(app PRIVATE
    src/main.c
)

# Synthetic PCG source
target_sources(app PRIVATE
    src/audio/i2s_capture.c
)

# DSP chain — STFT + mel filterbank
target_sources(app PRIVATE
    src/dsp/mel_spec.c
)

# TFLite Micro inference wrapper (C++ file) + on-device validation
# + USART2 audio bridge for phone -> BLE -> nRF -> STM32 path
target_sources(app PRIVATE
    src/ml/inference.cc
    src/ml/model_data.cc
    src/ml/validate.c
    src/ml/audio_bridge.c
)

# BLE/UART communication to nRF52840
target_sources(app PRIVATE
    src/comms/ble_client.c
)

target_include_directories(app PRIVATE
    src
    src/audio
    src/dsp
    src/ml
    src/comms
)
```

## prj.conf
```kconfig
# =============================================================================
# Digital Stethoscope — STM32U575 Kconfig
# =============================================================================

# Console / logging
CONFIG_STDOUT_CONSOLE=y
CONFIG_UART_CONSOLE=y
# Console UART is binary-clean for the dashboard audio-upload protocol.
# Zephyr log text on the same UART corrupts the returned float32 spectrogram
# bytes, so CONFIG_LOG is not enabled.
# CONFIG_LOG is not set
# CONFIG_LOG_DEFAULT_LEVEL is not set

# Audio source
# Current revision: no ICS-43434 microphone. Synthetic PCG strings are rendered
# locally on the STM32U575 and fed into DSP + TFLite Micro.
# Re-enable I2S/DMA when a future SAI/I2S microphone source is added.
# CONFIG_I2S is not set
# CONFIG_DMA is not set

# CMSIS-DSP for STFT (arm_rfft_fast_f32, arm_dot_prod_f32, arm_mean_f32)
CONFIG_CMSIS_DSP=y
CONFIG_CMSIS_DSP_TRANSFORM=y
CONFIG_CMSIS_DSP_STATISTICS=y
CONFIG_CMSIS_DSP_BASICMATH=y
CONFIG_FPU=y

# C++ runtime — required by TFLite Micro (C++17, PICOLIBC default libc)
CONFIG_CPP=y
CONFIG_STD_CPP17=y

# TFLite Micro — Phase 2: tflite-micro module fetched via west update
CONFIG_TENSORFLOW_LITE_MICRO=y
CONFIG_TENSORFLOW_LITE_MICRO_CMSIS_NN_KERNELS=y

# Stack and heap — Phase 2
# Tensor arena (100 KB) is statically allocated in inference.cc — not from heap.
# Heap covers Zephyr kernel + C++ runtime overhead only.
CONFIG_MAIN_STACK_SIZE=4096
CONFIG_HEAP_MEM_POOL_SIZE=65536

# Multi-threading
CONFIG_NUM_PREEMPT_PRIORITIES=16

# UART for BLE bridge / debug output
CONFIG_UART_INTERRUPT_DRIVEN=y

# Large ring buffer support for the 40 KB audio-upload RX FIFO in validate.c.
CONFIG_RING_BUFFER_LARGE=y

# Math functions (log10f, sqrtf) — provided by PICOLIBC (board default)
# CONFIG_NEWLIB_LIBC is NOT set — conflicts with the board's PICOLIBC choice
```

## app.overlay
```dts
/*
 * Digital Stethoscope - STM32U575 devicetree overlay
 *
 * Current revision:
 *   - No active ICS-43434 microphone path.
 *   - Synthetic PCG strings are rendered in firmware and classified locally.
 *   - USART2 is enabled for the nRF52840 UART bridge.
 *     PD5 (USART_B_TX, NUCLEO header D53) -> nRF P0.08 (UART1 RX).
 *     PD6 (USART_B_RX) is configured but not wired (TX-only bridge).
 *
 * Future microphone option:
 *   STM32U575 uses SAI rather than a classic I2S peripheral. If a compatible
 *   SAI/I2S microphone is added later, re-enable &sai1_b and CONFIG_I2S/DMA.
 */

/* SAI1 Block B is intentionally disabled for the synthetic-data build. */
&sai1_b {
    status = "disabled";
};

/* USART2 - bridge to nRF52840 (PD5 TX -> nRF P0.08) */
&usart2 {
    status = "okay";
    pinctrl-0 = <&usart2_tx_pd5 &usart2_rx_pd6>;
    pinctrl-names = "default";
    current-speed = <115200>;
};
```

## src/main.c
```c
/*
 * Digital Stethoscope — main.c
 * STM32U575 NUCLEO-U575ZI-Q
 *
 * Spawns four Zephyr threads communicating via message queues:
 *
 *   AudioCaptureThread  (prio 2)  → audio_q
 *   DSPThread           (prio 4)  → spectrogram_q
 *   InferenceThread     (prio 6)  → result_q
 *   CommThread          (prio 8)  → UART TX to nRF52840
 *
 * Current revision: AudioCaptureThread uses synthetic PCG strings on a
 * dashboard-controlled 2-second timer. The STM32U575 still runs DSP and
 * ML inference locally.
 */

#include <zephyr/kernel.h>
#include <zephyr/logging/log.h>
#include <zephyr/sys/util.h>

#include "audio/i2s_capture.h"
#include "dsp/mel_spec.h"
#include "ml/inference.h"
#include "ml/validate.h"
#include "ml/audio_bridge.h"
#include "comms/ble_client.h"

LOG_MODULE_REGISTER(main, LOG_LEVEL_INF);

/* -------------------------------------------------------------------------
 * Message queue definitions
 * ------------------------------------------------------------------------- */

/* Audio buffer: 8000 samples × float32 = 32 KB per message
 * Depth 1 is enough for the current synthetic string source. */
#define AUDIO_BUF_SAMPLES  8000
K_MSGQ_DEFINE(audio_q, sizeof(float) * AUDIO_BUF_SAMPLES, 1, 4);

/* Spectrogram: 64×64 float32 = 16 KB per message, depth 1 */
#define SPEC_ROWS  64
#define SPEC_COLS  64
K_MSGQ_DEFINE(spectrogram_q, sizeof(float) * SPEC_ROWS * SPEC_COLS, 1, 4);

/* Result packet */
struct heart_result {
    uint8_t  class_id;       /* 0=Absent 1=Present 2=Unknown */
    uint8_t  confidence;     /* 0–100 */
    uint32_t timestamp_ms;
};
K_MSGQ_DEFINE(result_q, sizeof(struct heart_result), 4, 4);

/* -------------------------------------------------------------------------
 * Thread stacks
 * ------------------------------------------------------------------------- */
#define AUDIO_STACK     2048
#define DSP_STACK       4096
#define INFER_STACK     8192
#define COMM_STACK      2048
#define VALIDATE_STACK  2048

K_THREAD_STACK_DEFINE(audio_stack,    AUDIO_STACK);
K_THREAD_STACK_DEFINE(dsp_stack,      DSP_STACK);
K_THREAD_STACK_DEFINE(infer_stack,    INFER_STACK);
K_THREAD_STACK_DEFINE(comm_stack,     COMM_STACK);
K_THREAD_STACK_DEFINE(validate_stack, VALIDATE_STACK);

static struct k_thread audio_thread_data;
static struct k_thread dsp_thread_data;
static struct k_thread infer_thread_data;
static struct k_thread comm_thread_data;
static struct k_thread validate_thread_data;

/* -------------------------------------------------------------------------
 * Thread functions
 * ------------------------------------------------------------------------- */

static void audio_capture_thread(void *p1, void *p2, void *p3)
{
    ARG_UNUSED(p1); ARG_UNUSED(p2); ARG_UNUSED(p3);

    static float audio_buf[AUDIO_BUF_SAMPLES];

    LOG_INF("AudioCaptureThread started");

    /* Starts the synthetic source in paused mode. Dashboard sends 'S' to run. */
    audio_capture_init();

    while (1) {
        /* Blocking call: fills audio_buf with one 2-second window */
        audio_capture_get_window(audio_buf, AUDIO_BUF_SAMPLES);

        /* Push to DSP queue; drop oldest if full (prevents audio overrun) */
        if (k_msgq_put(&audio_q, audio_buf, K_NO_WAIT) != 0) {
            LOG_WRN("audio_q full — dropped oldest");
            k_msgq_purge(&audio_q);
            k_msgq_put(&audio_q, audio_buf, K_NO_WAIT);
        }
    }
}

static void dsp_thread(void *p1, void *p2, void *p3)
{
    ARG_UNUSED(p1); ARG_UNUSED(p2); ARG_UNUSED(p3);

    static float audio_in[AUDIO_BUF_SAMPLES];
    static float spec_out[SPEC_ROWS * SPEC_COLS];

    LOG_INF("DSPThread started");

    mel_spec_init();

    while (1) {
        k_msgq_get(&audio_q, audio_in, K_FOREVER);

        k_mutex_lock(&g_mel_spec_mutex, K_FOREVER);
        mel_spec_compute(audio_in, AUDIO_BUF_SAMPLES, spec_out, SPEC_ROWS, SPEC_COLS);
        k_mutex_unlock(&g_mel_spec_mutex);

        if (k_msgq_put(&spectrogram_q, spec_out, K_NO_WAIT) != 0) {
            LOG_WRN("spectrogram_q full — dropped");
        }
    }
}

static void inference_thread(void *p1, void *p2, void *p3)
{
    ARG_UNUSED(p1); ARG_UNUSED(p2); ARG_UNUSED(p3);

    static float spec_in[SPEC_ROWS * SPEC_COLS];
    struct heart_result res;

    LOG_INF("InferenceThread started");

    inference_init();

    static const char *class_names[] = {
        "Absent", "Present", "Unknown"
    };

    while (1) {
        k_msgq_get(&spectrogram_q, spec_in, K_FOREVER);

        uint32_t t0 = k_uptime_get_32();
        k_mutex_lock(&g_inference_mutex, K_FOREVER);
        int class_id = inference_run(spec_in, SPEC_ROWS * SPEC_COLS, &res.confidence);
        k_mutex_unlock(&g_inference_mutex);
        uint32_t latency = k_uptime_get_32() - t0;

        if (class_id < 0) {
            LOG_ERR("Inference failed");
            continue;
        }

        res.class_id     = (uint8_t)class_id;
        res.timestamp_ms = k_uptime_get_32();

        LOG_INF("Class: %-12s  Confidence: %3u%%  Latency: %ums",
                (class_id < ARRAY_SIZE(class_names)) ? class_names[class_id] : "INVALID",
                res.confidence, latency);

        k_msgq_put(&result_q, &res, K_NO_WAIT);
    }
}

static void comm_thread(void *p1, void *p2, void *p3)
{
    ARG_UNUSED(p1); ARG_UNUSED(p2); ARG_UNUSED(p3);

    struct heart_result res;

    LOG_INF("CommThread started");

    ble_client_init();

    while (1) {
        k_msgq_get(&result_q, &res, K_FOREVER);
        ble_client_send(res.class_id, res.confidence, res.timestamp_ms);
    }
}

/* -------------------------------------------------------------------------
 * main
 * ------------------------------------------------------------------------- */

int main(void)
{
    LOG_INF("=== Digital Stethoscope v0.1 ===");
    LOG_INF("Board: nucleo_u575zi_q");

    k_thread_create(&audio_thread_data, audio_stack, AUDIO_STACK,
                    audio_capture_thread, NULL, NULL, NULL,
                    2, 0, K_NO_WAIT);
    k_thread_name_set(&audio_thread_data, "audio_capture");

    k_thread_create(&dsp_thread_data, dsp_stack, DSP_STACK,
                    dsp_thread, NULL, NULL, NULL,
                    4, 0, K_NO_WAIT);
    k_thread_name_set(&dsp_thread_data, "dsp");

    k_thread_create(&infer_thread_data, infer_stack, INFER_STACK,
                    inference_thread, NULL, NULL, NULL,
                    6, 0, K_NO_WAIT);
    k_thread_name_set(&infer_thread_data, "inference");

    k_thread_create(&comm_thread_data, comm_stack, COMM_STACK,
                    comm_thread, NULL, NULL, NULL,
                    8, 0, K_NO_WAIT);
    k_thread_name_set(&comm_thread_data, "comm");

    /* Validate thread: lowest priority — only active during bench testing.
     * Listens on console UART for 'T'+index commands from
     * ml/05_validate_on_device.py and returns inference results. */
    k_thread_create(&validate_thread_data, validate_stack, VALIDATE_STACK,
                    validate_thread_fn, NULL, NULL, NULL,
                    9, 0, K_NO_WAIT);
    k_thread_name_set(&validate_thread_data, "validate");

    /* Audio bridge: listens on USART2 RX (PD6) for 'B' + 16 KB int16 PCM
     * forwarded by the nRF52840 from the phone's BLE audio_input write
     * characteristic. Runs the same DSP + inference path and returns the
     * result via ble_client_send() over USART2 TX (PD5). */
    audio_bridge_init();

    return 0;
}
```
